## boards/microchip/mpfs_disco_kit/Kconfig
```kconfig
# Copyright (c) 2024 Brett Witherspoon
# SPDX-License-Identifier: Apache-2.0

config BOARD_MPFS_DISCO_KIT
	select 64BIT
	select SCHED_IPI_SUPPORTED
	select CPU_HAS_FPU_DOUBLE_PRECISION
```

## boards/microchip/mpfs_disco_kit/Kconfig.mpfs_disco_kit
```kconfig
# Copyright (c) 2024 Brett Witherspoon
# SPDX-License-Identifier: Apache-2.0

config BOARD_MPFS_DISCO_KIT
	select SOC_POLARFIRE
```

## boards/microchip/mpfs_disco_kit/board.yml
```yaml
board:
  name: mpfs_disco_kit
  vendor: microchip
  socs:
  - name: polarfire
    variants:
    - name: "smp"
    - name: "smp_scratchpad"
```

## west.yml
```yaml
manifest:
  remotes:
    - name: zephyrproject-rtos
      url-base: https://github.com/zephyrproject-rtos

  projects:
    - name: zephyr
      remote: zephyrproject-rtos
      revision: fd0e46506fabd4c0c91ecb336a39cb6a6aa2b270 # v3.7.0-rc3
      import:
        name-allowlist:
          - hal_microchip
```
